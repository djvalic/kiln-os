## buildroot/package/ad5x-bootloader/Config.in
```kconfig
config BR2_PACKAGE_AD5X_BOOTLOADER
	bool "ad5x-bootloader"
	help
	  Kiln's own boot loader for the AD5X: Kiln's SPL and mainline
	  U-Boot (v2026.10 with u-boot/patches), built and checked by
	  u-boot/build.sh with Buildroot's toolchain. Only the images go
	  into the image (/usr/share/ad5x/bootloader: spl-mmc.img,
	  u-boot-emmc.img, SHA256SUMS, report.txt), for the recovery
	  OS's opt-in installer (ad5x-bootloader-install). Nothing writes
	  them unless the user runs it. docs/own-boot-loader.md.
```

## buildroot/package/ad5x-kernel66/Config.in
```kconfig
config BR2_PACKAGE_AD5X_KERNEL66
	bool "ad5x-kernel66"
	# regulatory.db and its signature are built into the kernel
	# (build.sh, REGDB_DIR)
	select BR2_PACKAGE_WIRELESS_REGDB
	help
	  Our 6.6 kernel (Ingenic's X2600 SDK kernel with the AD5X device
	  tree and patches, kernel-ingenic66/) and chainload.ko, which starts
	  it from the printer's stock 5.10 kernel at every boot
	  (S00ad5x-kernel). Installed in
	  /usr/lib/ad5x/kernel66; the boot slots keep the stock kernel.

	  Needs a checkout of the Ingenic SDK (see kernel-ingenic66/README.md)
	  and the 5.10 header tree for chainload.ko
	  (kernel-ingenic66/chainload/setup.sh).

if BR2_PACKAGE_AD5X_KERNEL66

config BR2_PACKAGE_AD5X_KERNEL66_SDK
	string "Ingenic 6.6 SDK checkout"
	default "$(HOME)/workspace/ingenic-sdk-6.6"

config BR2_PACKAGE_AD5X_KERNEL66_KDIR510
	string "linux-5.10.186 tree for chainload.ko"
	default "$(HOME)/workspace/chainload-build/linux-5.10.186"

endif
```

## buildroot/package/ad5x-memtest/Config.in
```kconfig
config BR2_PACKAGE_AD5X_MEMTEST
	bool "ad5x-memtest"
	depends on BR2_INIT_BUSYBOX
	help
	  Extended memory mode's one-time test of the X2600H's high
	  DRAM bank (0x30000000-0x3fffffff), on the first start with
	  the mode on: ad5x-memtest-high (static; pagemap-filtered
	  pattern passes over the bank's free pages) run by
	  S05ad5x-memtest, which records the result in
	  /data/ad5x/kernel and turns the mode off on a fault
	  (docs/memory.md). Main OS only. The kernel needs
	  CONFIG_PROC_PAGE_MONITOR (/proc/self/pagemap) and HIGHMEM.
```

## buildroot/package/fluidd/Config.in
```kconfig
config BR2_PACKAGE_FLUIDD
	bool "fluidd"
	depends on BR2_USE_MMU # nginx
	select BR2_PACKAGE_NGINX
	select BR2_PACKAGE_NGINX_HTTP
	select BR2_PACKAGE_NGINX_HTTP_PROXY_MODULE
	select BR2_PACKAGE_NGINX_HTTP_MAP_MODULE
	select BR2_PACKAGE_NGINX_HTTP_GUNZIP_MODULE # nginx.conf, assets/
	select BR2_PACKAGE_NGINX_HTTP_GZIP_STATIC_MODULE
	help
	  Fluidd, the web front end for Klipper/Moonraker: the prebuilt
	  release, in /usr/share/fluidd, served by nginx on port 80
	  (/etc/nginx/nginx.conf, S63nginx) with Moonraker proxied.

	  https://github.com/fluidd-core/fluidd
```

## buildroot/package/mainsail/Config.in
```kconfig
config BR2_PACKAGE_MAINSAIL
	bool "mainsail"
	depends on BR2_USE_MMU # nginx
	select BR2_PACKAGE_NGINX
	select BR2_PACKAGE_NGINX_HTTP
	select BR2_PACKAGE_NGINX_HTTP_PROXY_MODULE
	select BR2_PACKAGE_NGINX_HTTP_MAP_MODULE
	select BR2_PACKAGE_NGINX_HTTP_GZIP_MODULE
	select BR2_PACKAGE_NGINX_HTTP_GUNZIP_MODULE # nginx.conf, assets/
	select BR2_PACKAGE_NGINX_HTTP_GZIP_STATIC_MODULE # nginx.conf
	help
	  Mainsail, the other web front end for Klipper/Moonraker: the
	  prebuilt release, in /usr/share/mainsail. Off by default on the
	  printer: Fluidd is served on port 80 until the owner picks
	  Mainsail (ad5x-webui mainsail, POST /machine/kiln_os/webui;
	  docs/web-interface.md). One of the two is served at a time, by
	  the same nginx server as Fluidd.

	  https://github.com/mainsail-crew/mainsail
```
