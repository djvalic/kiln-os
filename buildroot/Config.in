## buildroot/Config.in
```kconfig
menu "AD5X"

config BR2_AD5X_BUNDLE_VENDOR
	bool "Bundle Flashforge/Ingenic files (private builds only)"
	help
	  Copy the stock driver modules (/module_driver), stock's board
	  tools and libraries (cmd_gpio, cmd_fb, cmd_jpeg_display,
	  libhardware2, libutils2, libjpeg.so.9) and the stock kernel
	  from the local, git-ignored firmware download into the image
	  and images/. Off (the default) gives a vendor-free image for
	  release: the printer then uses its own copies in
	  /data/ad5x/vendor (ad5x-vendor, docs/install.md). The
	  environment variable AD5X_VENDOR_FREE=1 (or 0) overrides this.

endmenu

source "$BR2_EXTERNAL_AD5X_PATH/package/klipper/Config.in"
source "$BR2_EXTERNAL_AD5X_PATH/package/moonraker/Config.in"
source "$BR2_EXTERNAL_AD5X_PATH/package/fluidd/Config.in"
source "$BR2_EXTERNAL_AD5X_PATH/package/helixscreen/Config.in"
source "$BR2_EXTERNAL_AD5X_PATH/package/python-inotify-simple/Config.in"
source "$BR2_EXTERNAL_AD5X_PATH/package/python-libnacl/Config.in"
source "$BR2_EXTERNAL_AD5X_PATH/package/python-streaming-form-data/Config.in"
source "$BR2_EXTERNAL_AD5X_PATH/package/ad5x-system/Config.in"
source "$BR2_EXTERNAL_AD5X_PATH/package/ad5x-kernel66/Config.in"
source "$BR2_EXTERNAL_AD5X_PATH/package/ad5x-kernel-mainline/Config.in"
source "$BR2_EXTERNAL_AD5X_PATH/package/ad5x-recovery/Config.in"
source "$BR2_EXTERNAL_AD5X_PATH/package/ad5x-lvgl/Config.in"
source "$BR2_EXTERNAL_AD5X_PATH/package/ad5x-recovery-ui/Config.in"
```

## buildroot/package/ad5x-kernel-mainline/Config.in
```kconfig
config BR2_PACKAGE_AD5X_KERNEL_MAINLINE
	bool "ad5x-kernel-mainline"
	depends on BR2_PACKAGE_AD5X_KERNEL66 # chainload.ko, the fallback
	help
	  Mainline Linux 7.3.3 with the AD5X patch series and Kiln's
	  kernel options (kernel-mainline/: patches, kiln.config,
	  build.sh). Installed in /usr/lib/ad5x/kernel-mainline. Off by
	  default on the printer: "ad5x-kernel mainline on" makes
	  S00ad5x-kernel start it instead of 6.6; a failed start falls
	  back to 6.6 in the same boot.

	  build.sh downloads linux-7.3.3.tar.xz from kernel.org and the
	  rtw8821c firmware from linux-firmware (both sha256-pinned).
```

## buildroot/package/happy-hare/Config.in
```kconfig
config BR2_PACKAGE_HAPPY_HARE
	bool "happy-hare"
	depends on BR2_PACKAGE_KLIPPER
	depends on BR2_PACKAGE_MOONRAKER
	help
	  Happy Hare multi-material MMU software (v4) for Klipper and Moonraker.
	  Supports servoless linear selector MMUs, active sync-feedback buffers,
	  and native integration with HelixScreen and web UIs.

	  https://github.com/moggieuk/Happy-Hare
```

## buildroot/package/helixscreen/Config.in
```kconfig
config BR2_PACKAGE_HELIXSCREEN
	bool "helixscreen"
	depends on BR2_INSTALL_LIBSTDCPP
	depends on BR2_TOOLCHAIN_HAS_THREADS
	depends on BR2_TOOLCHAIN_GCC_AT_LEAST_8 # C++17, std::filesystem
	select BR2_PACKAGE_OPENSSL
	select BR2_PACKAGE_ZLIB
	select BR2_PACKAGE_LIBDRM
	help
	  HelixScreen, an LVGL touch screen UI for Klipper/Moonraker,
	  built from source for the panel: DRM/KMS, or the framebuffer
	  (fbdev) on kernels without a DRM driver, and evdev touch. In /usr/lib/helixscreen; started by
	  S70helixscreen when /data/ad5x/helixscreen.enable exists.

	  https://github.com/prestonbrown/helixscreen
```
